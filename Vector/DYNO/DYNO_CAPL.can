/*@!Encoding:1252*/
includes
{
  
}

variables
{
  int USER_request_freq = 10; // in Hz (edit this one)
  int USER_request_freq_ms;
  int USER_wpOverridePercent_int;
  msTimer USER_request_timer;
  message USER_request1 USER_request1_msg; // decleration of message into a variable
  message USER_request2 USER_request2_msg;
}

on start // this gets called only on measurement start
{
  USER_request_freq_ms = 1000 / USER_request_freq; // calculate the ms for desired freq
  setTimer(USER_request_timer, USER_request_freq_ms); // set the initial timer
}


on timer USER_request_timer
{
  // reset the timer
  setTimer(USER_request_timer, USER_request_freq_ms);
  
  USER_request1_msg.USER_rpmRequest = @Vector::USER_rpmRequest;
  USER_request1_msg.USER_throttleRequest = @Vector::USER_throttleRequest / USER_request1_msg.USER_throttleRequest.factor;
  USER_request1_msg.USER_wpOverrideStatus = @Vector::USER_wpOverrideStatus;
  USER_request1_msg.USER_wpOverridePercent = @Vector::USER_wpOverridePercent;
  output(USER_request1_msg);
  //write("PUMP: %i", @Vector::USER_wpOverrideStatus);
}

on sysvar_update Vector::USER_updatePID
{
  USER_request2_msg.USER_throttleKp = @Vector::USER_throttleKp;
  USER_request2_msg.USER_throttleKi = @Vector::USER_throttleKi;
  USER_request2_msg.USER_throttleKd = @Vector::USER_throttleKd;
  output(USER_request2_msg);
}



/*@!Encoding:1252*/
includes
{
  
}

variables
{
  int USER_request_freq = 20; // in Hz (edit this one)
  int USER_request_freq_ms;
  msTimer USER_request_timer;
  message USER_request1 USER_request1_msg; // decleration of message into a variable
}

on start // this gets called only on measurement start
{
  USER_request_freq_ms = 1000 / USER_request_freq; // calculate the ms for desired freq
  setTimer(USER_request_timer, USER_request_freq_ms); // set the initial timer
}

on sysvar Vector::ETC_throttleRequest
{
  // assigns the ETC_throttleRequest system value to the message byte
  //msg_ETC_request.ETC_throttleRequest = @this;
  //output (msg_ETC_request);
}

on timer etc_update_timer
{
  msg_ETC_request.ETC_throttleRequest = @Vector::ETC_throttleRequest;
  //output(msg_ETC_request);
  setTimer(etc_update_timer, ETC_freq_ms);
  write("ETC PERCENT: %f", @Vector::ETC_throttleRequest);
}


